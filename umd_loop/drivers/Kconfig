## umd_loop/drivers/Kconfig
```kconfig
# Copyright (c) 2026 UMD Loop
# SPDX-License-Identifier: Apache-2.0

menu "UMD Loop drivers"

rsource "rgb_led/Kconfig"
rsource "servo/Kconfig"
rsource "tone/Kconfig"
rsource "comms/Kconfig"

endmenu
```

## umd_loop/drivers/comms/Kconfig
```kconfig
# Copyright (c) 2026 UMD Loop
# SPDX-License-Identifier: Apache-2.0

config UMD_LOOP_COMMS
	bool "UMD Loop comms helpers (HEX UART / USB / I2C / status LED)"
	default y
	depends on SERIAL
	help
	  Protocol helpers for HEX color lines, UART readline, status blink,
	  and I2C message queue put.

if UMD_LOOP_COMMS

config UMD_LOOP_COMMS_INIT_PRIORITY
	int "Comms library init priority (unused for library-only)"
	default 70

endif
```

## umd_loop/drivers/rgb_led/Kconfig
```kconfig
# Copyright (c) 2026 UMD Loop
# SPDX-License-Identifier: Apache-2.0

config UMD_LOOP_RGB_LED
	bool "UMD Loop RGB LED driver"
	default y
	depends on GPIO
	depends on DT_HAS_UMDLOOP_RGB_LED_ENABLED
	help
	  Discrete RGB LED driver (three GPIOs, nearest-primary helper).

if UMD_LOOP_RGB_LED

config UMD_LOOP_RGB_LED_INIT_PRIORITY
	int "RGB LED init priority"
	default 70

endif
```

## umd_loop/drivers/servo/Kconfig
```kconfig
# Copyright (c) 2026 UMD Loop
# SPDX-License-Identifier: Apache-2.0

config UMD_LOOP_SERVO
	bool "UMD Loop servo PWM driver"
	default y
	depends on PWM
	depends on DT_HAS_UMDLOOP_SERVO_PWM_ENABLED
	help
	  Hobby servo driver (50 Hz PWM, 500-2000 us pulse).

if UMD_LOOP_SERVO

config UMD_LOOP_SERVO_INIT_PRIORITY
	int "Servo init priority"
	default 70

endif
```

## umd_loop/drivers/tone/Kconfig
```kconfig
# Copyright (c) 2026 UMD Loop
# SPDX-License-Identifier: Apache-2.0

config UMD_LOOP_TONE
	bool "UMD Loop tone / buzzer driver"
	default y
	depends on PWM
	depends on DT_HAS_UMDLOOP_TONE_ENABLED
	help
	  PWM square-wave tone with optional ADC duration mapping.

if UMD_LOOP_TONE

config UMD_LOOP_TONE_INIT_PRIORITY
	int "Tone init priority"
	default 70

endif
```

## umd_loop/dts/bindings/umdloop,rgb-led.yaml
```yaml
description: UMD Loop discrete RGB LED (three GPIO channels)

compatible: "umdloop,rgb-led"

include: base.yaml

properties:
  red-gpios:
    type: phandle-array
    required: true
    description: Red LED GPIO (active high)

  green-gpios:
    type: phandle-array
    required: true
    description: Green LED GPIO (active high)

  blue-gpios:
    type: phandle-array
    required: true
    description: Blue LED GPIO (active high)
```

## umd_loop/dts/bindings/umdloop,servo-pwm.yaml
```yaml
description: UMD Loop hobby servo driven by PWM

compatible: "umdloop,servo-pwm"

include: base.yaml

properties:
  pwms:
    type: phandle-array
    required: true
    description: PWM channel for the servo control signal (50 Hz)

  min-pulse-us:
    type: int
    required: false
    default: 500
    description: Pulse width in microseconds for 0 degrees

  max-pulse-us:
    type: int
    required: false
    default: 2000
    description: Pulse width in microseconds for 180 degrees
```

## umd_loop/dts/bindings/umdloop,tone.yaml
```yaml
description: UMD Loop tone/buzzer with optional ADC duration sensor

compatible: "umdloop,tone"

include: base.yaml

properties:
  pwms:
    type: phandle-array
    required: true
    description: PWM channel used to generate the square-wave tone

  io-channels:
    type: phandle-array
    required: false
    description: Optional ADC channel for duration mapping (E1 System 3)

  min-duration-ms:
    type: int
    required: false
    default: 200
    description: Tone duration at minimum ADC reading

  max-duration-ms:
    type: int
    required: false
    default: 2000
    description: Tone duration at maximum ADC reading
```
